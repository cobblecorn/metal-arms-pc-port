// ma_setup: builds the game data the PC port needs from the player's own Metal Arms disc.
//
// The port ships without any retail data. This tool takes the player's USA GameCube disc image,
// checks it, and extracts its files to gamedata\files beside itself, where ma_port.exe finds them.
//
//   .iso / .gcm                 read directly
//   .rvz / .gcz / .wia / .ciso  converted to a temporary .iso first with Dolphin's DolphinTool.exe
//                               (found beside this tool, in the usual Dolphin folders or on PATH, or
//                               picked by the player)
//
// Every extracted file is checked against disc_manifest.h (name, size and CRC32 of the retail
// files, generated by tools/make_disc_manifest.py), so only a clean copy of the release the port
// was built against is accepted.
//
// A small window: choose the image, Install, Play. Each run's messages also go to ma_setup.log.
//
//   ma_setup [disc image] [-dolphintool <DolphinTool.exe>] [-auto]
// A disc image dropped onto ma_setup.exe arrives as the first argument. -auto (for tests) installs
// at once without questions, closes when done and returns 0 on success.

#define WIN32_LEAN_AND_MEAN
#include <windows.h>
#include <commctrl.h>
#include <commdlg.h>
#include <shellapi.h>
#include <stdarg.h>
#include <stdio.h>
#include <wchar.h>
#include <string>
#include <vector>

#include "disc_manifest.h"

#pragma comment( linker, "\"/manifestdependency:type='win32' name='Microsoft.Windows.Common-Controls' version='6.0.0.0' " \
	"processorArchitecture='*' publicKeyToken='6595b64144ccf1df' language='*'\"" )

static const wchar_t *_pwszDataDir = L"gamedata\\files";
static const unsigned int _nMaxFstBytes = 1u << 20;

enum {
	_ID_PATH = 100, _ID_BROWSE, _ID_INSTALL, _ID_PLAY, _ID_CLOSE, _ID_PROGRESS, _ID_STATUS, _ID_INTRO,
	_WM_PROGRESS = WM_APP + 1,	// wParam: percent, or -1 for "working, no percentage"
	_WM_STATUS,					// lParam: new std::wstring, freed by the window
	_WM_DONE,					// wParam: TRUE on success
};

static std::wstring _sToolDir;			// where ma_setup.exe is; the data goes here
static std::wstring _sDataDir;
static std::wstring _sGivenDolphinTool;
static bool _bAuto = false;
static int _nExitCode = 1;

static HWND _hWnd, _hPath, _hBrowse, _hInstall, _hPlay, _hClose, _hProgress, _hStatus;
static HFONT _hFont, _hTitleFont;
static int _nDpi = 96;

static volatile LONG _bWorking = 0, _bCancel = 0;
static HANDLE _hChildProcess = NULL;	// DolphinTool while it runs, so Cancel can stop it

//////////////////////////////////////////////////////////////////////////
// Helpers

static int _Px( int n ) { return MulDiv( n, _nDpi, 96 ); }

static void _Log( const wchar_t *pwszFormat, ... ) {
	wchar_t wszLine[2048];
	va_list Args;
	va_start( Args, pwszFormat );
	_vsnwprintf( wszLine, 2047, pwszFormat, Args );
	wszLine[2047] = 0;
	va_end( Args );
	FILE *pFile = _wfopen( ( _sToolDir + L"\\ma_setup.log" ).c_str(), L"a, ccs=UTF-8" );
	if( pFile ) {
		SYSTEMTIME Now;
		GetLocalTime( &Now );
		fwprintf( pFile, L"%02d:%02d:%02d %ls\n", Now.wHour, Now.wMinute, Now.wSecond, wszLine );
		fclose( pFile );
	}
}

// From the worker: show (and log) a status line.
static void _Status( const wchar_t *pwszFormat, ... ) {
	wchar_t wszLine[2048];
	va_list Args;
	va_start( Args, pwszFormat );
	_vsnwprintf( wszLine, 2047, pwszFormat, Args );
	wszLine[2047] = 0;
	va_end( Args );
	_Log( L"%ls", wszLine );
	PostMessageW( _hWnd, _WM_STATUS, 0, (LPARAM)new std::wstring( wszLine ) );
}

static bool _FileExists( const std::wstring &sPath ) {
	const DWORD dwAttributes = GetFileAttributesW( sPath.c_str() );
	return dwAttributes != INVALID_FILE_ATTRIBUTES && !( dwAttributes & FILE_ATTRIBUTE_DIRECTORY );
}

static std::wstring _Extension( const std::wstring &sPath ) {
	const size_t nDot = sPath.find_last_of( L'.' );
	const size_t nSlash = sPath.find_last_of( L"\\/" );
	if( nDot == std::wstring::npos || ( nSlash != std::wstring::npos && nDot < nSlash ) ) {
		return L"";
	}
	std::wstring sExt = sPath.substr( nDot + 1 );
	for( wchar_t &c : sExt ) c = towlower( c );
	return sExt;
}

static std::wstring _ManifestPath( const DiscManifestFile &rFile ) {
	wchar_t wszName[MAX_PATH];
	MultiByteToWideChar( 1252, 0, rFile.pszPath, -1, wszName, MAX_PATH );
	std::wstring sPath = _sDataDir + L"\\" + wszName;
	for( wchar_t &c : sPath ) if( c == L'/' ) c = L'\\';
	return sPath;
}

static bool _MakeDirs( const std::wstring &sDir ) {
	for( size_t i = 3; i <= sDir.size(); i++ ) {
		if( i == sDir.size() || sDir[i] == L'\\' ) {
			const std::wstring sPart = sDir.substr( 0, i );
			if( !CreateDirectoryW( sPart.c_str(), NULL ) && GetLastError() != ERROR_ALREADY_EXISTS ) {
				return false;
			}
		}
	}
	return true;
}

static unsigned long long _FreeBytes( const std::wstring &sDir ) {
	ULARGE_INTEGER Free = {};
	GetDiskFreeSpaceExW( sDir.c_str(), &Free, NULL, NULL );
	return Free.QuadPart;
}

static bool _PickFile( HWND hOwner, const wchar_t *pwszTitle, const wchar_t *pwszFilter, std::wstring &rsPath ) {
	wchar_t wszPath[MAX_PATH * 4] = {};
	OPENFILENAMEW Ofn = {};
	Ofn.lStructSize = sizeof( Ofn );
	Ofn.hwndOwner = hOwner;
	Ofn.lpstrFilter = pwszFilter;
	Ofn.lpstrFile = wszPath;
	Ofn.nMaxFile = MAX_PATH * 4;
	Ofn.lpstrTitle = pwszTitle;
	Ofn.Flags = OFN_FILEMUSTEXIST | OFN_PATHMUSTEXIST | OFN_HIDEREADONLY;
	if( !GetOpenFileNameW( &Ofn ) ) {
		return false;
	}
	rsPath = wszPath;
	return true;
}

// Every file present at its retail size.
static bool _AlreadyInstalled( void ) {
	for( unsigned int m = 0; m < DISC_FILE_COUNT; m++ ) {
		WIN32_FILE_ATTRIBUTE_DATA Info;
		if( !GetFileAttributesExW( _ManifestPath( Disc_aFiles[m] ).c_str(), GetFileExInfoStandard, &Info ) ||
			Info.nFileSizeHigh != 0 || Info.nFileSizeLow != Disc_aFiles[m].nSize ) {
			return false;
		}
	}
	return true;
}

//////////////////////////////////////////////////////////////////////////
// CRC32 (zlib's polynomial, matching tools/make_disc_manifest.py)

static unsigned int _anCrcTable[256];

static void _InitCrc( void ) {
	for( unsigned int n = 0; n < 256; n++ ) {
		unsigned int c = n;
		for( int k = 0; k < 8; k++ ) {
			c = ( c & 1 ) ? 0xEDB88320u ^ ( c >> 1 ) : c >> 1;
		}
		_anCrcTable[n] = c;
	}
}

static unsigned int _Crc( unsigned int nCrc, const unsigned char *pData, size_t nBytes ) {
	nCrc = ~nCrc;
	for( size_t i = 0; i < nBytes; i++ ) {
		nCrc = _anCrcTable[( nCrc ^ pData[i] ) & 0xFF] ^ ( nCrc >> 8 );
	}
	return ~nCrc;
}

//////////////////////////////////////////////////////////////////////////
// Compressed images: DolphinTool converts them to a plain .iso

static std::wstring _FindDolphinTool( void ) {
	if( !_sGivenDolphinTool.empty() ) {
		return _FileExists( _sGivenDolphinTool ) ? _sGivenDolphinTool : L"";
	}
	std::vector<std::wstring> aCandidates;
	aCandidates.push_back( _sToolDir + L"\\DolphinTool.exe" );
	aCandidates.push_back( _sToolDir + L"\\Dolphin\\DolphinTool.exe" );
	const wchar_t *apwszEnv[] = { L"ProgramFiles", L"ProgramW6432", L"ProgramFiles(x86)", L"LOCALAPPDATA" };
	const wchar_t *apwszSub[] = { L"\\Dolphin\\DolphinTool.exe", L"\\Dolphin-x64\\DolphinTool.exe",
								  L"\\Programs\\Dolphin\\DolphinTool.exe", L"\\Dolphin Emulator\\DolphinTool.exe" };
	for( const wchar_t *pwszEnv : apwszEnv ) {
		wchar_t wszBase[MAX_PATH];
		if( GetEnvironmentVariableW( pwszEnv, wszBase, MAX_PATH ) ) {
			for( const wchar_t *pwszSub : apwszSub ) {
				aCandidates.push_back( std::wstring( wszBase ) + pwszSub );
			}
		}
	}
	for( const std::wstring &sCandidate : aCandidates ) {
		if( _FileExists( sCandidate ) ) {
			return sCandidate;
		}
	}
	wchar_t wszFound[MAX_PATH];
	if( SearchPathW( NULL, L"DolphinTool.exe", NULL, MAX_PATH, wszFound, NULL ) ) {
		return wszFound;
	}
	return L"";
}

static bool _ConvertToIso( const std::wstring &sDolphinTool, const std::wstring &sImage, const std::wstring &sIso ) {
	DeleteFileW( sIso.c_str() );
	std::wstring sCommand = L"\"" + sDolphinTool + L"\" convert -i \"" + sImage + L"\" -o \"" + sIso + L"\" -f iso";
	std::vector<wchar_t> aCommand( sCommand.begin(), sCommand.end() );
	aCommand.push_back( 0 );
	STARTUPINFOW Startup = { sizeof( Startup ) };
	Startup.dwFlags = STARTF_USESHOWWINDOW;
	Startup.wShowWindow = SW_HIDE;
	PROCESS_INFORMATION Process = {};
	if( !CreateProcessW( NULL, aCommand.data(), NULL, NULL, FALSE, CREATE_NO_WINDOW, NULL, NULL, &Startup, &Process ) ) {
		_Status( L"Could not start DolphinTool (error %lu).", GetLastError() );
		return false;
	}
	_hChildProcess = Process.hProcess;
	WaitForSingleObject( Process.hProcess, INFINITE );
	DWORD dwExit = 1;
	GetExitCodeProcess( Process.hProcess, &dwExit );
	_hChildProcess = NULL;
	CloseHandle( Process.hThread );
	CloseHandle( Process.hProcess );
	if( _bCancel ) {
		return false;
	}
	if( dwExit != 0 || !_FileExists( sIso ) ) {
		_Status( L"DolphinTool could not convert the image (exit code %lu).", dwExit );
		return false;
	}
	return true;
}

//////////////////////////////////////////////////////////////////////////
// The disc

class CDisc {
public:
	~CDisc() { if( m_hFile != INVALID_HANDLE_VALUE ) CloseHandle( m_hFile ); }

	bool Open( const std::wstring &sPath ) {
		m_hFile = CreateFileW( sPath.c_str(), GENERIC_READ, FILE_SHARE_READ, NULL, OPEN_EXISTING, FILE_FLAG_SEQUENTIAL_SCAN, NULL );
		if( m_hFile == INVALID_HANDLE_VALUE ) {
			return false;
		}
		LARGE_INTEGER Size;
		GetFileSizeEx( m_hFile, &Size );
		m_nSize = (unsigned long long)Size.QuadPart;
		return true;
	}

	bool Read( unsigned long long nOffset, void *pDest, unsigned int nBytes ) {
		if( nOffset + nBytes > m_nSize ) {
			return false;
		}
		LARGE_INTEGER Pos;
		Pos.QuadPart = (LONGLONG)nOffset;
		DWORD dwRead = 0;
		return SetFilePointerEx( m_hFile, Pos, NULL, FILE_BEGIN ) && ReadFile( m_hFile, pDest, nBytes, &dwRead, NULL ) && dwRead == nBytes;
	}

private:
	HANDLE m_hFile = INVALID_HANDLE_VALUE;
	unsigned long long m_nSize = 0;
};

struct DiscFile_t { std::string sPath; unsigned int nOffset, nSize; };

static unsigned int _BE32( const unsigned char *p ) {
	return ( (unsigned int)p[0] << 24 ) | ( (unsigned int)p[1] << 16 ) | ( (unsigned int)p[2] << 8 ) | p[3];
}

// The disc's file system table: every file with its path, offset and size.
static bool _ReadFst( CDisc &rDisc, std::vector<DiscFile_t> &raFiles ) {
	unsigned char aHeader[0x440];
	if( !rDisc.Read( 0, aHeader, sizeof( aHeader ) ) ) {
		return false;
	}
	const unsigned int nFstOffset = _BE32( aHeader + 0x424 ), nFstSize = _BE32( aHeader + 0x428 );
	if( nFstSize < 12 || nFstSize > _nMaxFstBytes ) {
		return false;
	}
	std::vector<unsigned char> aFst( nFstSize );
	if( !rDisc.Read( nFstOffset, aFst.data(), nFstSize ) ) {
		return false;
	}
	const unsigned int nEntries = _BE32( &aFst[8] );
	if( nEntries == 0 || (unsigned long long)nEntries * 12 > nFstSize ) {
		return false;
	}
	const unsigned int nStrings = nEntries * 12;
	struct Dir_t { unsigned int nEnd; std::string sPrefix; };
	std::vector<Dir_t> aDirs;
	aDirs.push_back( { nEntries, "" } );
	for( unsigned int i = 1; i < nEntries; i++ ) {
		const unsigned char *pEntry = &aFst[i * 12];
		const unsigned int nWord = _BE32( pEntry ), nA = _BE32( pEntry + 4 ), nB = _BE32( pEntry + 8 );
		while( !aDirs.empty() && i >= aDirs.back().nEnd ) {
			aDirs.pop_back();
		}
		const unsigned int nName = nStrings + ( nWord & 0xFFFFFF );
		if( nName >= nFstSize ) {
			return false;
		}
		std::string sName;
		for( unsigned int c = nName; c < nFstSize && aFst[c]; c++ ) {
			sName += (char)aFst[c];
		}
		const std::string sPrefix = aDirs.empty() ? "" : aDirs.back().sPrefix;
		if( nWord >> 24 ) {
			aDirs.push_back( { nB, sPrefix + sName + "/" } );
		} else {
			raFiles.push_back( { sPrefix + sName, nA, nB } );
		}
	}
	return true;
}

static bool _Extract( CDisc &rDisc ) {
	char szGameId[7] = {};
	if( !rDisc.Read( 0, szGameId, 6 ) ) {
		_Status( L"Could not read the disc image." );
		return false;
	}
	if( strcmp( szGameId, DISC_GAME_ID ) != 0 ) {
		_Status( L"This is not the USA GameCube release of Metal Arms (disc ID %hs, expected %hs).", szGameId, DISC_GAME_ID );
		return false;
	}
	std::vector<DiscFile_t> aFiles;
	if( !_ReadFst( rDisc, aFiles ) ) {
		_Status( L"The disc's file table could not be read; the image may be damaged." );
		return false;
	}

	_Status( L"Copying and checking the game files..." );
	std::vector<unsigned char> aBuffer( 4u << 20 );
	unsigned long long nDone = 0;
	int nLastPercent = -1;
	for( unsigned int m = 0; m < DISC_FILE_COUNT; m++ ) {
		const DiscManifestFile &rWant = Disc_aFiles[m];
		const DiscFile_t *pFile = NULL;
		for( const DiscFile_t &rFile : aFiles ) {
			if( rFile.sPath == rWant.pszPath ) {
				pFile = &rFile;
				break;
			}
		}
		if( !pFile || pFile->nSize != rWant.nSize ) {
			_Status( L"%hs is missing or a different size on this disc. Use a clean, unmodified dump.", rWant.pszPath );
			return false;
		}

		const std::wstring sOut = _ManifestPath( rWant );
		_MakeDirs( sOut.substr( 0, sOut.find_last_of( L'\\' ) ) );
		const std::wstring sTemp = sOut + L".part";
		HANDLE hOut = CreateFileW( sTemp.c_str(), GENERIC_WRITE, 0, NULL, CREATE_ALWAYS, FILE_FLAG_SEQUENTIAL_SCAN, NULL );
		if( hOut == INVALID_HANDLE_VALUE ) {
			_Status( L"Could not write %ls (error %lu).", sTemp.c_str(), GetLastError() );
			return false;
		}
		unsigned int nCrc = 0, nLeft = pFile->nSize;
		unsigned long long nOffset = pFile->nOffset;
		bool bOk = true;
		while( nLeft && bOk && !_bCancel ) {
			const unsigned int nChunk = nLeft < aBuffer.size() ? nLeft : (unsigned int)aBuffer.size();
			DWORD dwWritten = 0;
			bOk = rDisc.Read( nOffset, aBuffer.data(), nChunk ) &&
				  WriteFile( hOut, aBuffer.data(), nChunk, &dwWritten, NULL ) && dwWritten == nChunk;
			nCrc = _Crc( nCrc, aBuffer.data(), nChunk );
			nOffset += nChunk;
			nLeft -= nChunk;
			nDone += nChunk;
			const int nPercent = (int)( nDone * 100 / DISC_TOTAL_BYTES );
			if( nPercent != nLastPercent ) {
				nLastPercent = nPercent;
				PostMessageW( _hWnd, _WM_PROGRESS, nPercent, 0 );
			}
		}
		CloseHandle( hOut );
		if( _bCancel ) {
			DeleteFileW( sTemp.c_str() );
			return false;
		}
		if( !bOk ) {
			DeleteFileW( sTemp.c_str() );
			_Status( L"Could not copy %hs (is the drive full, or the image cut short?).", rWant.pszPath );
			return false;
		}
		if( nCrc != rWant.nCrc ) {
			DeleteFileW( sTemp.c_str() );
			_Status( L"%hs does not match the retail disc. Use a clean, unmodified dump of your disc.", rWant.pszPath );
			_Log( L"  checksum %08X, expected %08X", nCrc, rWant.nCrc );
			return false;
		}
		if( !MoveFileExW( sTemp.c_str(), sOut.c_str(), MOVEFILE_REPLACE_EXISTING ) ) {
			_Status( L"Could not finish %ls (error %lu).", sOut.c_str(), GetLastError() );
			return false;
		}
	}
	return true;
}

//////////////////////////////////////////////////////////////////////////
// The install, on a worker thread

struct Job_t { std::wstring sImage, sDolphinTool; };

static DWORD WINAPI _InstallThread( void *pParam ) {
	Job_t *pJob = (Job_t *)pParam;
	_Log( L"Install from %ls", pJob->sImage.c_str() );
	bool bOk = false;
	std::wstring sIso = pJob->sImage, sTempIso;

	if( !_MakeDirs( _sDataDir ) ) {
		_Status( L"Could not create %ls.", _sDataDir.c_str() );
	} else if( !pJob->sDolphinTool.empty() ) {
		sTempIso = _sToolDir + L"\\gamedata\\setup-temp.iso";
		_Status( L"Converting the disc image with Dolphin (about a minute)..." );
		PostMessageW( _hWnd, _WM_PROGRESS, (WPARAM)-1, 0 );
		_Log( L"DolphinTool: %ls", pJob->sDolphinTool.c_str() );
		if( _ConvertToIso( pJob->sDolphinTool, pJob->sImage, sTempIso ) ) {
			sIso = sTempIso;
		} else {
			sIso.clear();
		}
	}

	if( !sIso.empty() && !_bCancel ) {
		CDisc Disc;
		if( !Disc.Open( sIso ) ) {
			_Status( L"Could not open %ls.", sIso.c_str() );
		} else {
			bOk = _Extract( Disc );
		}
	}
	if( !sTempIso.empty() ) {
		DeleteFileW( sTempIso.c_str() );
	}
	if( _bCancel ) {
		_Status( L"Cancelled." );
		bOk = false;
	}
	_Log( bOk ? L"Install complete." : L"Install did not complete." );
	PostMessageW( _hWnd, _WM_DONE, bOk, 0 );
	delete pJob;
	return 0;
}

//////////////////////////////////////////////////////////////////////////
// The window

static void _SetWorking( bool bWorking ) {
	InterlockedExchange( &_bWorking, bWorking );
	EnableWindow( _hBrowse, !bWorking );
	EnableWindow( _hPath, !bWorking );
	EnableWindow( _hInstall, !bWorking );
	EnableWindow( _hPlay, !bWorking && _AlreadyInstalled() );
	SetWindowTextW( _hClose, bWorking ? L"Cancel" : L"Close" );
}

static void _ShowInstalledState( void ) {
	const bool bInstalled = _AlreadyInstalled();
	SetWindowTextW( _hInstall, bInstalled ? L"Reinstall" : L"Install" );
	EnableWindow( _hPlay, bInstalled );
	if( bInstalled ) {
		SendMessageW( _hProgress, PBM_SETPOS, 100, 0 );
		SetWindowTextW( _hStatus, L"The game files are installed. Press Play to start." );
	} else {
		SetWindowTextW( _hStatus, L"Choose your disc image, then press Install." );
	}
}

static void _StartInstall( void ) {
	wchar_t wszPath[MAX_PATH * 4];
	GetWindowTextW( _hPath, wszPath, MAX_PATH * 4 );
	Job_t *pJob = new Job_t;
	pJob->sImage = wszPath;
	if( pJob->sImage.empty() || !_FileExists( pJob->sImage ) ) {
		delete pJob;
		if( _bAuto ) { DestroyWindow( _hWnd ); return; }
		MessageBoxW( _hWnd, L"Choose your Metal Arms disc image first.", L"Metal Arms Setup", MB_ICONINFORMATION );
		return;
	}

	const std::wstring sExt = _Extension( pJob->sImage );
	unsigned long long nNeeded = DISC_TOTAL_BYTES + ( 64ull << 20 );
	if( sExt != L"iso" && sExt != L"gcm" ) {
		pJob->sDolphinTool = _FindDolphinTool();
		if( pJob->sDolphinTool.empty() ) {
			if( _bAuto ) { delete pJob; DestroyWindow( _hWnd ); return; }
			MessageBoxW( _hWnd,
				L"This disc image is compressed (.rvz, .gcz, .wia or .ciso). Setup converts it with DolphinTool.exe, "
				L"which comes with the Dolphin emulator (dolphin-emu.org).\n\n"
				L"Please show setup where DolphinTool.exe is, in your Dolphin folder.\n\n"
				L"(Or convert the image to .iso in Dolphin: right-click the game, Convert File.)",
				L"Metal Arms Setup", MB_ICONINFORMATION );
			if( !_PickFile( _hWnd, L"Locate DolphinTool.exe", L"DolphinTool.exe\0DolphinTool.exe\0", pJob->sDolphinTool ) ) {
				delete pJob;
				return;
			}
			_sGivenDolphinTool = pJob->sDolphinTool;
		}
		nNeeded += 1500ull << 20;	// the temporary .iso
	}
	if( _FreeBytes( _sToolDir ) < nNeeded ) {
		wchar_t wszMessage[256];
		_snwprintf( wszMessage, 255, L"Setup needs about %llu MB of free space on this drive.", nNeeded >> 20 );
		wszMessage[255] = 0;
		_Log( L"%ls", wszMessage );
		delete pJob;
		if( _bAuto ) { DestroyWindow( _hWnd ); return; }
		MessageBoxW( _hWnd, wszMessage, L"Metal Arms Setup", MB_ICONWARNING );
		return;
	}

	InterlockedExchange( &_bCancel, 0 );
	SendMessageW( _hProgress, PBM_SETPOS, 0, 0 );
	_SetWorking( true );
	HANDLE hThread = CreateThread( NULL, 0, _InstallThread, pJob, 0, NULL );
	if( hThread ) {
		CloseHandle( hThread );
	} else {
		delete pJob;
		_SetWorking( false );
	}
}

static void _Launch( void ) {
	const std::wstring sGame = _sToolDir + L"\\ma_port.exe";
	if( !_FileExists( sGame ) ) {
		MessageBoxW( _hWnd, L"ma_port.exe is not in this folder. Keep the downloaded files together.", L"Metal Arms Setup", MB_ICONWARNING );
		return;
	}
	ShellExecuteW( NULL, L"open", sGame.c_str(), NULL, _sToolDir.c_str(), SW_SHOWNORMAL );
	DestroyWindow( _hWnd );
}

static HWND _Child( const wchar_t *pwszClass, const wchar_t *pwszText, DWORD dwStyle, int x, int y, int w, int h, int nId, HFONT hFont ) {
	HWND hChild = CreateWindowExW( 0, pwszClass, pwszText, WS_CHILD | WS_VISIBLE | dwStyle,
								   _Px( x ), _Px( y ), _Px( w ), _Px( h ), _hWnd, (HMENU)(INT_PTR)nId, GetModuleHandleW( NULL ), NULL );
	SendMessageW( hChild, WM_SETFONT, (WPARAM)hFont, TRUE );
	return hChild;
}

static LRESULT CALLBACK _WndProc( HWND hWnd, UINT nMsg, WPARAM wParam, LPARAM lParam ) {
	switch( nMsg ) {
	case WM_CREATE: {
		_hWnd = hWnd;
		_Child( L"STATIC", L"Metal Arms: Glitch in the System \x2014 PC Setup", SS_LEFT, 16, 14, 488, 26, 0, _hTitleFont );
		_Child( L"STATIC", L"This copies the game's files from your own Metal Arms disc image (USA GameCube release) "
						   L"into this folder and checks every file. Supported: .iso, .gcm, .rvz, .gcz, .wia, .ciso.",
				SS_LEFT, 16, 46, 488, 36, _ID_INTRO, _hFont );
		_Child( L"STATIC", L"Disc image:", SS_LEFT, 16, 94, 488, 18, 0, _hFont );
		_hPath = CreateWindowExW( WS_EX_CLIENTEDGE, L"EDIT", L"", WS_CHILD | WS_VISIBLE | ES_AUTOHSCROLL,
								  _Px( 16 ), _Px( 113 ), _Px( 392 ), _Px( 24 ), hWnd, (HMENU)_ID_PATH, GetModuleHandleW( NULL ), NULL );
		SendMessageW( _hPath, WM_SETFONT, (WPARAM)_hFont, TRUE );
		_hBrowse = _Child( L"BUTTON", L"Browse...", BS_PUSHBUTTON, 416, 112, 88, 26, _ID_BROWSE, _hFont );
		_hProgress = _Child( PROGRESS_CLASSW, L"", PBS_SMOOTH, 16, 152, 488, 18, _ID_PROGRESS, _hFont );
		SendMessageW( _hProgress, PBM_SETRANGE32, 0, 100 );
		_hStatus = _Child( L"STATIC", L"", SS_LEFT | SS_ENDELLIPSIS, 16, 176, 488, 36, _ID_STATUS, _hFont );
		_hInstall = _Child( L"BUTTON", L"Install", BS_DEFPUSHBUTTON, 224, 222, 88, 28, _ID_INSTALL, _hFont );
		_hPlay = _Child( L"BUTTON", L"Play", BS_PUSHBUTTON, 320, 222, 88, 28, _ID_PLAY, _hFont );
		_hClose = _Child( L"BUTTON", L"Close", BS_PUSHBUTTON, 416, 222, 88, 28, _ID_CLOSE, _hFont );
		DragAcceptFiles( hWnd, TRUE );
		_ShowInstalledState();
		return 0;
	}

	case WM_CTLCOLORSTATIC:
		SetBkMode( (HDC)wParam, TRANSPARENT );
		return (LRESULT)GetSysColorBrush( COLOR_WINDOW );

	case WM_DROPFILES: {
		wchar_t wszPath[MAX_PATH * 4];
		if( !_bWorking && DragQueryFileW( (HDROP)wParam, 0, wszPath, MAX_PATH * 4 ) ) {
			SetWindowTextW( _hPath, wszPath );
		}
		DragFinish( (HDROP)wParam );
		return 0;
	}

	case WM_COMMAND:
		switch( LOWORD( wParam ) ) {
		case _ID_BROWSE: {
			std::wstring sPath;
			if( _PickFile( hWnd, L"Choose your Metal Arms (USA) GameCube disc image",
						   L"GameCube disc images\0*.iso;*.gcm;*.rvz;*.gcz;*.wia;*.ciso\0All files\0*.*\0", sPath ) ) {
				SetWindowTextW( _hPath, sPath.c_str() );
			}
			return 0;
		}
		case _ID_INSTALL:
			_StartInstall();
			return 0;
		case _ID_PLAY:
			_Launch();
			return 0;
		case _ID_CLOSE:
		case IDCANCEL:
			SendMessageW( hWnd, WM_CLOSE, 0, 0 );
			return 0;
		}
		break;

	case _WM_PROGRESS:
		if( (int)wParam < 0 ) {
			SetWindowLongPtrW( _hProgress, GWL_STYLE, GetWindowLongPtrW( _hProgress, GWL_STYLE ) | PBS_MARQUEE );
			SendMessageW( _hProgress, PBM_SETMARQUEE, TRUE, 30 );
		} else {
			if( GetWindowLongPtrW( _hProgress, GWL_STYLE ) & PBS_MARQUEE ) {
				SendMessageW( _hProgress, PBM_SETMARQUEE, FALSE, 0 );
				SetWindowLongPtrW( _hProgress, GWL_STYLE, GetWindowLongPtrW( _hProgress, GWL_STYLE ) & ~PBS_MARQUEE );
			}
			SendMessageW( _hProgress, PBM_SETPOS, wParam, 0 );
		}
		return 0;

	case _WM_STATUS: {
		std::wstring *pText = (std::wstring *)lParam;
		SetWindowTextW( _hStatus, pText->c_str() );
		delete pText;
		return 0;
	}

	case _WM_DONE:
		_WndProc( hWnd, _WM_PROGRESS, wParam ? 100 : 0, 0 );
		_SetWorking( false );
		_nExitCode = wParam ? 0 : 1;
		if( _bAuto ) {
			DestroyWindow( hWnd );
			return 0;
		}
		if( wParam ) {
			_ShowInstalledState();
			SetWindowTextW( _hStatus, L"Done: all game files are installed and match the retail disc. Press Play to start." );
			SetFocus( _hPlay );
		} else {
			SetWindowTextW( _hInstall, L"Install" );
		}
		return 0;

	case WM_CLOSE:
		if( _bWorking ) {
			if( _bAuto || MessageBoxW( hWnd, L"Stop the install?", L"Metal Arms Setup", MB_YESNO | MB_ICONQUESTION ) == IDYES ) {
				InterlockedExchange( &_bCancel, 1 );
				if( _hChildProcess ) {
					TerminateProcess( _hChildProcess, 1 );
				}
				SetWindowTextW( _hStatus, L"Stopping..." );
			}
			return 0;
		}
		DestroyWindow( hWnd );
		return 0;

	case WM_DESTROY:
		PostQuitMessage( 0 );
		return 0;
	}
	return DefWindowProcW( hWnd, nMsg, wParam, lParam );
}

int WINAPI wWinMain( HINSTANCE hInstance, HINSTANCE, LPWSTR, int nShow ) {
	SetProcessDPIAware();
	_InitCrc();
	wchar_t wszExe[MAX_PATH * 4];
	GetModuleFileNameW( NULL, wszExe, MAX_PATH * 4 );
	_sToolDir = wszExe;
	_sToolDir = _sToolDir.substr( 0, _sToolDir.find_last_of( L"\\/" ) );
	_sDataDir = _sToolDir + L"\\" + _pwszDataDir;

	std::wstring sImage;
	int argc = 0;
	wchar_t **argv = CommandLineToArgvW( GetCommandLineW(), &argc );
	for( int i = 1; argv && i < argc; i++ ) {
		if( !_wcsicmp( argv[i], L"-auto" ) ) _bAuto = true;
		else if( !_wcsicmp( argv[i], L"-dolphintool" ) && i + 1 < argc ) _sGivenDolphinTool = argv[++i];
		else sImage = argv[i];
	}
	LocalFree( argv );

	INITCOMMONCONTROLSEX Init = { sizeof( Init ), ICC_PROGRESS_CLASS | ICC_STANDARD_CLASSES };
	InitCommonControlsEx( &Init );

	HDC hScreen = GetDC( NULL );
	_nDpi = GetDeviceCaps( hScreen, LOGPIXELSY );
	ReleaseDC( NULL, hScreen );
	NONCLIENTMETRICSW Metrics = { sizeof( Metrics ) };
	SystemParametersInfoW( SPI_GETNONCLIENTMETRICS, sizeof( Metrics ), &Metrics, 0 );
	Metrics.lfMessageFont.lfHeight = -_Px( 12 );
	_hFont = CreateFontIndirectW( &Metrics.lfMessageFont );
	Metrics.lfMessageFont.lfHeight = -_Px( 17 );
	Metrics.lfMessageFont.lfWeight = FW_SEMIBOLD;
	_hTitleFont = CreateFontIndirectW( &Metrics.lfMessageFont );

	WNDCLASSEXW Class = { sizeof( Class ) };
	Class.lpfnWndProc = _WndProc;
	Class.hInstance = hInstance;
	Class.hIcon = LoadIconW( hInstance, MAKEINTRESOURCEW( 1 ) );
	Class.hIconSm = Class.hIcon;
	Class.hCursor = LoadCursorW( NULL, IDC_ARROW );
	Class.hbrBackground = GetSysColorBrush( COLOR_WINDOW );
	Class.lpszClassName = L"MetalArmsSetup";
	RegisterClassExW( &Class );

	const DWORD dwStyle = WS_OVERLAPPED | WS_CAPTION | WS_SYSMENU | WS_MINIMIZEBOX;
	RECT Rect = { 0, 0, _Px( 520 ), _Px( 266 ) };
	AdjustWindowRect( &Rect, dwStyle, FALSE );
	const int nWidth = Rect.right - Rect.left, nHeight = Rect.bottom - Rect.top;
	CreateWindowExW( 0, Class.lpszClassName, L"Metal Arms PC Setup", dwStyle,
					 ( GetSystemMetrics( SM_CXSCREEN ) - nWidth ) / 2, ( GetSystemMetrics( SM_CYSCREEN ) - nHeight ) / 2,
					 nWidth, nHeight, NULL, NULL, hInstance, NULL );
	if( !_hWnd ) {
		return 1;
	}
	if( !sImage.empty() ) {
		SetWindowTextW( _hPath, sImage.c_str() );
	}
	ShowWindow( _hWnd, _bAuto ? SW_SHOWMINNOACTIVE : nShow );
	UpdateWindow( _hWnd );
	if( _bAuto ) {
		_StartInstall();
	}

	MSG Msg;
	while( GetMessageW( &Msg, NULL, 0, 0 ) > 0 ) {
		if( !IsDialogMessageW( _hWnd, &Msg ) ) {
			TranslateMessage( &Msg );
			DispatchMessageW( &Msg );
		}
	}
	DeleteObject( _hFont );
	DeleteObject( _hTitleFont );
	return _nExitCode;
}
